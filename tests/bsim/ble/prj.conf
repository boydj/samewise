## CMakeLists.txt
```
cmake_minimum_required(VERSION 3.20.0)

find_package(Zephyr REQUIRED HINTS $ENV{ZEPHYR_BASE})
project(wx_bsim_ble)

add_subdirectory(${ZEPHYR_BASE}/tests/bsim/babblekit babblekit)
target_link_libraries(app PRIVATE babblekit)

FILE(GLOB app_sources src/*.c)
target_sources(app PRIVATE ${app_sources})

zephyr_include_directories(
  ${BSIM_COMPONENTS_PATH}/libUtilv1/src/
  ${BSIM_COMPONENTS_PATH}/libPhyComv1/src/
)
```

## prj.conf
```kconfig
# One image plays the radio (device 0) and the phones (devices 1-3),
# chosen by -testid.
CONFIG_BT=y
CONFIG_BT_DEVICE_NAME="WX Radio"
CONFIG_BT_PERIPHERAL=y
CONFIG_BT_CENTRAL=y
CONFIG_BT_SMP=y
CONFIG_BT_GATT_CLIENT=y
CONFIG_BT_MAX_CONN=1
CONFIG_BT_MAX_PAIRED=2
CONFIG_BT_ATT_PREPARE_COUNT=6
CONFIG_BT_L2CAP_TX_MTU=247
CONFIG_BT_BUF_ACL_TX_SIZE=251
CONFIG_BT_BUF_ACL_RX_SIZE=251
CONFIG_WX_BLE_ZEPHYR=y
# The phones report a security error instead of pairing on their own, so
# the test sees the refusal (an iPhone would start pairing here).
CONFIG_BT_ATT_RETRY_ON_SEC_ERR=n

# Firmware updates: SMP over Bluetooth, authenticated (LESC-only) links.
CONFIG_NET_BUF=y
CONFIG_ZCBOR=y
CONFIG_MCUMGR=y
CONFIG_MCUMGR_TRANSPORT_BT=y
CONFIG_MCUMGR_TRANSPORT_BT_PERM_RW_AUTHEN=y
CONFIG_MCUMGR_GRP_OS=y

# The radio, on the native_sim fakes.
CONFIG_WX_APP_LOGIC=y
CONFIG_WX_FAKE_AUDIO_IN=y
CONFIG_WX_FAKE_ALERT_OUT=y
CONFIG_WX_FAKE_AUDIO_OUT=y
CONFIG_WX_FAKE_BATTERY=y
CONFIG_WX_FAKE_DISPLAY=y
CONFIG_WX_FAKE_CLOCK=y
CONFIG_WX_FAKE_INPUT=y
CONFIG_WX_FAKE_STORAGE=y
CONFIG_WX_FAKE_TUNER=y
CONFIG_WX_FAKE_WATCHDOG=y

CONFIG_LOG=y
CONFIG_ASSERT=y
CONFIG_MAIN_STACK_SIZE=4096
```

## src/main.c
```c
/*
 * Bluetooth settings on nrf52_bsim: one image, one test per device.
 */

#include "bstests.h"

extern struct bst_test_list *test_radio_install(struct bst_test_list *tests);
extern struct bst_test_list *test_phone_install(struct bst_test_list *tests);

bst_test_install_t test_installers[] = {
	test_radio_install,
	test_phone_install,
	NULL,
};

int main(void)
{
	bst_main();
	return 0;
}
```

## src/link.c
```c
/*
 * Backchannel between the simulated devices.
 */

#include <zephyr/kernel.h>

#include "argparse.h"
#include "bs_pc_backchannel.h"
#include "link.h"

/* Index in our channel list of each device (ours is unused). */
static unsigned int index_of[DEV_COUNT];

void link_init(void)
{
	unsigned int self = get_device_nbr();
	unsigned int peers[DEV_COUNT - 1];
	unsigned int channels[DEV_COUNT - 1];
	unsigned int n = 0;

	for (unsigned int d = 0; d < DEV_COUNT; d++) {
		if (d == self) {
			continue;
		}
		index_of[d] = n;
		peers[n] = d;
		channels[n] = 0;
		n++;
	}
	__ASSERT_NO_MSG(bs_open_back_channel(self, peers, channels, n) != NULL);
}

void link_send(unsigned int dev, const struct link_msg *m)
{
	bs_bc_send_msg(index_of[dev], (uint8_t *)m, sizeof(*m));
}

bool link_poll(unsigned int dev, struct link_msg *m)
{
	if (bs_bc_is_msg_received(index_of[dev]) <= 0) {
		return false;
	}
	bs_bc_receive_msg(index_of[dev], (uint8_t *)m, sizeof(*m));
	return true;
}

struct link_msg link_wait(unsigned int dev)
{
	struct link_msg m;

	while (!link_poll(dev, &m)) {
		k_sleep(K_MSEC(1));
	}
	return m;
}

struct link_msg radio_ask(enum link_cmd cmd, uint8_t a, uint16_t b)
{
	struct link_msg m = {.cmd = (uint8_t)cmd, .a = a, .b = b};

	link_send(DEV_RADIO, &m);
	m = link_wait(DEV_RADIO);
	__ASSERT(m.cmd == LINK_STATE, "radio answered %u", m.cmd);
	return m;
}
```

## src/link.h
```c
/*
 * Backchannel between the simulated devices: the phones script the test
 * and ask the radio to press keys, change fakes and report its state. The
 * passkey travels this way, as a person would read it off the screen.
 */

#ifndef BSIM_BLE_LINK_H_
#define BSIM_BLE_LINK_H_

#include <stdbool.h>
#include <stdint.h>

enum {
	DEV_RADIO,
	DEV_PHONE1,
	DEV_PHONE2,
	DEV_PHONE3,
	DEV_COUNT,
};

enum link_cmd {
	/* To the radio; it answers each with LINK_STATE. */
	LINK_KEY,      /* a = enum hal_input_event_type, b = keys */
	LINK_QUERY,
	LINK_BATTERY,  /* a = percent */
	LINK_SIGNAL,   /* a = RSSI dBuV, b = SNR dB */
	LINK_DONE,     /* phone 1: the test is over */
	/* From the radio. */
	LINK_STATE,
	/* Between phones. */
	LINK_GO,
};

/* LINK_STATE.a: flags; .b: ble_screen; .c: UTC seconds; .d: passkey; .e: bonds. */
#define LINK_HFXO      0x01U
#define LINK_CONNECTED 0x02U
#define LINK_SECURE    0x04U
#define LINK_WINDOW    0x08U

struct link_msg {
	uint8_t cmd;
	uint8_t a;
	uint16_t b;
	uint32_t c;
	uint32_t d;
	uint32_t e;
};

void link_init(void);
void link_send(unsigned int dev, const struct link_msg *m);
bool link_poll(unsigned int dev, struct link_msg *m);
struct link_msg link_wait(unsigned int dev);

/* Phone helpers: a request to the radio and its state reply. */
struct link_msg radio_ask(enum link_cmd cmd, uint8_t a, uint16_t b);

#endif /* BSIM_BLE_LINK_H_ */
```

## src/radio.c
```c
/*
 * Device 0: the radio. The whole application on the native fakes, with
 * the Bluetooth service on Zephyr's real host. Fake time follows the
 * simulation's time in 10 ms steps, with healthy heartbeats, so windows,
 * confirmations and battery polls run as on the board.
 *
 * It serves the phones' requests (keys, fakes, state) until phone 1 says
 * the test is over.
 */

#include <zephyr/kernel.h>

#include "app/radio.h"
#include "babblekit/testcase.h"
#include "bstests.h"
#include "fakes/alert_out_fake.h"
#include "fakes/audio_out_fake.h"
#include "fakes/battery_fake.h"
#include "fakes/clock_fake.h"
#include "fakes/input_fake.h"
#include "fakes/storage_fake.h"
#include "fakes/tuner_fake.h"
#include "fakes/watchdog_fake.h"
#include "link.h"
#include "services/ble/ble_zephyr.h"
#include "services/same/same_decoder.h"

#define STEP_MS 10
/* 2026-10-01T00:00:00Z */
#define EPOCH 1790812800LL

static struct radio radio;
static uint32_t watchdog_resets;

static void on_watchdog_reset(void *user)
{
	ARG_UNUSED(user);
	watchdog_resets++;
}

static struct link_msg state(void)
{
	const struct ble *b = &radio.ble;
	struct link_msg m = {.cmd = LINK_STATE};

	m.a = (clock_fake_hfxo_on() ? LINK_HFXO : 0U) | (b->connected ? LINK_CONNECTED : 0U) |
	      (b->secure ? LINK_SECURE : 0U) | (b->window != BLE_WINDOW_NONE ? LINK_WINDOW : 0U);
	m.b = radio.ui.ble_screen;
	m.c = (uint32_t)hal_clock_utc_s();
	m.d = radio.ui.ble_screen == BLE_SCREEN_PASSKEY ? radio.ui.passkey : 0U;
	m.e = ble_zephyr_port.bond_count(NULL);
	return m;
}

/* Returns false when the test is over. */
static bool serve(unsigned int dev, const struct link_msg *m)
{
	struct link_msg reply;

	switch (m->cmd) {
	case LINK_KEY:
		input_fake_emit((enum hal_input_event_type)m->a, m->b);
		break;
	case LINK_BATTERY:
		battery_fake_set(m->a, 3800, HAL_BATTERY_DISCHARGING);
		break;
	case LINK_SIGNAL:
		tuner_fake_set_signal((int16_t)m->a, (int16_t)m->b);
		break;
	case LINK_DONE:
		return false;
	default:
		break;
	}
	reply = state();
	link_send(dev, &reply);
	return true;
}

static void test_radio_main(void)
{
	static const struct health_config cfg = HEALTH_CONFIG_DEFAULT;
	bool running = true;
	int err;

	link_init();
	clock_fake_reset();
	storage_fake_init();
	alert_out_fake_init();
	audio_out_fake_init();
	input_fake_init();
	tuner_fake_init();
	battery_fake_init();
	watchdog_fake_init(on_watchdog_reset, NULL);
	radio_boot(&radio, &cfg, EPOCH);
	radio_ble_start(&radio, &ble_zephyr_port, NULL);
	err = ble_zephyr_init(&radio.ble);
	TEST_ASSERT(err == 0, "Bluetooth failed to start (%d)", err);
	TEST_START("radio");

	while (running) {
		struct link_msg m;

		k_sleep(K_MSEC(STEP_MS));
		radio_idle_audio(&radio, (uint32_t)SAME_MS_TO_SAMPLES(STEP_MS));
		clock_fake_advance_ms(STEP_MS);
		radio_low_priority(&radio);
		for (unsigned int d = DEV_PHONE1; d < DEV_COUNT; d++) {
			while (running && link_poll(d, &m)) {
				running = serve(d, &m);
			}
		}
	}

	TEST_ASSERT(watchdog_resets == 0, "the radio reset %u times", watchdog_resets);
	TEST_ASSERT(clock_fake_hfxo_misuse() == 0, "crystal requests unbalanced");
	TEST_ASSERT(alert_mgr_state(&radio.alerts) != ALERT_STATE_LISTENING, "left standby");
	TEST_PASS("radio");
}

static const struct bst_test_instance test_radio[] = {
	{
		.test_id = "radio",
		.test_descr = "The radio: settings service, policy and fakes",
		.test_main_f = test_radio_main,
	},
	BSTEST_END_MARKER,
};

struct bst_test_list *test_radio_install(struct bst_test_list *tests)
{
	return bst_add_tests(tests, test_radio);
}
```
