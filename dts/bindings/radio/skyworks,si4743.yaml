## dts/bindings/radio/skyworks,si4743.yaml
```yaml
description: |
  Skyworks (Silicon Labs) Si4743 AM/FM/WB receiver on its 2-wire bus
  (AN332 section 6.1: address 0x11 with SEN low, 0x63 with SEN high).
  The board feeds it a 32.768 kHz reference on RCLK: the Si474x has no
  crystal oscillator option (AN332, POWER_UP: XOSCEN must be 0).

compatible: "skyworks,si4743"

include: i2c-device.yaml

properties:
  reset-gpios:
    type: phandle-array
    description: RST, active low. Optional; without it the driver never resets the chip.
```

## tests/app/alert_manager/testcase.yaml
```yaml
tests:
  app.alert_manager:
    platform_allow: native_sim
    integration_platforms:
      - native_sim
    tags: app
```

## tests/app/settings/testcase.yaml
```yaml
tests:
  app.settings:
    platform_allow: native_sim
    integration_platforms:
      - native_sim
    tags: app
```

## tests/app_smoke/testcase.yaml
```yaml
tests:
  app.smoke:
    platform_allow: native_sim
    integration_platforms:
      - native_sim
    harness: console
    harness_config:
      type: multi_line
      ordered: true
      regex:
        - "Pocket WX Radio firmware .*"
        - "WX BENCH START"
        - "WX HEADER ZCZC-WXR-TOR-048453\\+0030-2781915-KEWX/NWS-"
        - "WX EOM"
        - "WX BENCH END samples=89524 .*"
        - "WX BENCH DONE"
```

## tests/ble/tz/testcase.yaml
```yaml
tests:
  ble.tz:
    platform_allow: native_sim
    integration_platforms:
      - native_sim
    tags: ble
```

## tests/bsim/ble/testcase.yaml
```yaml
tests:
  wx.bsim.ble:
    build_only: true
    tags: ble
    platform_allow:
      - nrf52_bsim/native
    harness: bsim
    harness_config:
      bsim_exe_name: wx_ble
```

## tests/display/render/testcase.yaml
```yaml
tests:
  display.render:
    platform_allow: native_sim
    integration_platforms:
      - native_sim
    tags: display
```

## tests/drivers/display/testcase.yaml
```yaml
tests:
  drivers.display:
    platform_allow: native_sim
    integration_platforms:
      - native_sim
    tags: drivers display
```

## tests/drivers/tuner/testcase.yaml
```yaml
tests:
  drivers.tuner:
    platform_allow: native_sim
    integration_platforms:
      - native_sim
    tags: drivers tuner
```

## tests/fakes/clock/testcase.yaml
```yaml
tests:
  fakes.clock:
    platform_allow: native_sim
    integration_platforms:
      - native_sim
    tags: fakes
```

## tests/fakes/watchdog/testcase.yaml
```yaml
tests:
  fakes.watchdog:
    platform_allow: native_sim
    integration_platforms:
      - native_sim
    tags: fakes
```

## tests/gfx/testcase.yaml
```yaml
tests:
  gfx.draw:
    platform_allow: native_sim
    integration_platforms:
      - native_sim
    tags: gfx
```

## tests/hal_headers/testcase.yaml
```yaml
tests:
  hal.headers:
    platform_allow: native_sim
    integration_platforms:
      - native_sim
    tags: hal
```

## tests/match/event_table/testcase.yaml
```yaml
tests:
  match.event_table:
    platform_allow: native_sim
    integration_platforms:
      - native_sim
    tags: match
```

## tests/match/rules/testcase.yaml
```yaml
tests:
  match.rules:
    platform_allow: native_sim
    integration_platforms:
      - native_sim
    tags: match
```

## tests/same/snr/testcase.yaml
```yaml
tests:
  same.snr:
    platform_allow: native_sim
    integration_platforms:
      - native_sim
    tags: same
```

## tests/scenario/testcase.yaml
```yaml
tests:
  scenario.radio:
    platform_allow: native_sim
    integration_platforms:
      - native_sim
    tags: scenario
```

## zephyr/Kconfig
```kconfig
menu "Pocket WX Radio"

config WX_SAME
	bool "SAME decoder and header parser"
	help
	  Streaming SAME decoder (services/same). Plain C99.

config WX_MATCH
	bool "Event table, matcher, filter and duplicates"
	help
	  services/match. Plain C99.

config WX_BLE_CODEC
	bool "Bluetooth value codec and time zones"
	select WX_MATCH
	select WX_SAME
	help
	  services/ble codec and POSIX TZ parser. Plain C99.

config WX_BLE_SERVICE
	bool "Bluetooth settings service and connection policy"
	select WX_BLE_CODEC
	select WX_POWER
	help
	  services/ble/ble_service.c: characteristics and policy over a port
	  table, so it runs on native_sim without a controller.

config WX_BLE_ZEPHYR
	bool "Bluetooth service on Zephyr's Bluetooth host"
	depends on BT_PERIPHERAL && BT_SMP
	select WX_BLE_SERVICE
	select BT_GATT_DYNAMIC_DB
	select BT_SMP_APP_PAIRING_ACCEPT
	select BT_SMP_SC_ONLY
	select BT_FILTER_ACCEPT_LIST
	select BT_KEYS_OVERWRITE_OLDEST
	help
	  services/ble/ble_zephyr.c: the GATT service from gatt_table.h with
	  LE Secure Connections permissions, the filter accept list and
	  display-only passkey pairing. Set BT_MAX_PAIRED=2, BT_MAX_CONN=1 and
	  BT_ATT_PREPARE_COUNT=6 (long writes at the minimum MTU).

	  A third bond replaces the least recently used one (BT_KEYS_OVERWRITE_OLDEST
	  ages keys on use). Leave BT_KEYS_SAVE_AGING_COUNTER_ON_PAIRING off: it
	  would make that the oldest paired instead.

config WX_GFX
	bool "Drawing and bitmap fonts"
	help
	  services/gfx: rectangles, lines and VT323 bitmap text in a 1-bit
	  framebuffer. Plain C99.

config WX_POWER
	bool "Power manager"
	help
	  services/power: 32 MHz crystal requests.

config WX_APP_LOGIC
	bool "Application logic: settings, alert manager, health supervisor"
	select WX_SAME
	select WX_MATCH
	select WX_BLE_SERVICE
	select WX_GFX

menu "Fakes"
	comment "Stand-ins for interfaces; those reading host files need native_sim."

config WX_FAKE_AUDIO_IN
	bool "audio_in fake: WAV file reader"
	depends on ARCH_POSIX
	select WX_FAKE_HOST_FILE

config WX_FAKE_CLOCK
	bool "clock fake: simulated time"
	depends on !WX_DRV_CLOCK

config WX_FAKE_WATCHDOG
	bool "watchdog fake: starvation triggers a simulated reset"
	help
	  Uses hal/clock.h timers, so starvation happens in simulated time.

config WX_FAKE_STORAGE
	bool "storage fake: records in memory, surviving simulated resets"

config WX_FAKE_ALERT_OUT
	bool "alert_out fake: timestamped log of buzzer, vibration and LED"

config WX_FAKE_AUDIO_OUT
	bool "audio_out fake: amplifier and routing state"

config WX_FAKE_INPUT
	bool "input fake: scripted key, lock and headphone events"

config WX_FAKE_TUNER
	bool "tuner fake: scripted signal and faults, records calls"

config WX_FAKE_BATTERY
	bool "battery fake: scripted discharge curve, records ship mode"

config WX_FAKE_DISPLAY
	bool "display fake: framebuffer in RAM, flushes counted and holdable"

config WX_FAKE_HOST_FILE
	bool "Host file access for fakes and tests"
	depends on ARCH_POSIX
	help
	  Small shim over the host C library (open, read, write, close),
	  built into the native simulator runner.

endmenu

menu "Drivers"
	comment "Interfaces on real Zephyr subsystems (app/drivers)."

config WX_DRV_CLOCK
	bool "clock on the kernel's uptime, with timers on a supervisor work queue"
	help
	  hal/clock.h on the system timer (the nRF RTC on the board). Timer
	  callbacks run on one work queue thread, the radio's supervisor.

config WX_DRV_CLOCK_STACK_SIZE
	int "Supervisor work queue stack size"
	depends on WX_DRV_CLOCK
	default 2048

config WX_DRV_CLOCK_PRIORITY
	int "Supervisor work queue priority"
	depends on WX_DRV_CLOCK
	default 5

config WX_DRV_WATCHDOG
	bool "watchdog on the SoC watchdog, reset cause from hwinfo"
	depends on WATCHDOG && HWINFO

config WX_DRV_STORAGE
	bool "storage on Zephyr settings"
	depends on SETTINGS

config WX_DRV_BATTERY
	bool "battery on the MAX17048 fuel gauge and BQ25180 charger"
	depends on FUEL_GAUGE && CHARGER && I2C
	help
	  hal/battery.h on Zephyr's maxim,max17048 and ti,bq25180 drivers, plus
	  the charger's temperature status and shutdown mode by register.

config WX_DRV_DISPLAY
	bool "display on Zephyr's display API (zephyr,display)"
	depends on DISPLAY
	help
	  hal/display.h on the chosen display: the Sharp memory LCD through
	  sharp,ls0xx on the board, SDL on native_sim. Sends changed rows only.

config WX_AUDIO_CLIP
	bool "audio_in from a SAME clip compiled into flash"
	help
	  Streams a samegen clip (one header, three copies, then EOM) generated
	  at build time. The board's stand-in audio source until the ADC driver.

config WX_AUDIO_CLIP_BITS
	int "Bits per stored clip sample"
	depends on WX_AUDIO_CLIP
	range 8 16
	default 16
	help
	  16 keeps samegen's samples exactly; 8 halves the flash used.

endmenu

endmenu
```
